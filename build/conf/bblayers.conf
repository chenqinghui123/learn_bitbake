## build/conf/bblayers.conf
```bitbake
BBPATH := "${TOPDIR}"
BBFILES ?= ""
BBLAYERS = "/home/chenqinghui/bbTutorial/meta-tutorial \
         /home/chenqinghui/bbTutorial/meta-two \
	"
```

## meta-two/conf/layer.conf
```bitbake
PATH .= ":${LAYERDIR}"
BBFILES += "${LAYERDIR}/*.bb"
#append layer name to list of configured layers
BBFILE_COLLECTIONS += "two"
# and use name as suffix for other properties
BBFILE_PATTERN_two = "^${LAYERDIR}/"
BBFILE_PRIORITY_two = "5"
```
